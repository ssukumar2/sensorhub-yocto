## meta-sensorhub/conf/layer.conf
```bitbake
BBPATH .= ":${LAYERDIR}"
BBFILES += "${LAYERDIR}/recipes-*/*/*.bb"
BBFILE_COLLECTIONS += "meta-sensorhub"
BBFILE_PATTERN_meta-sensorhub = "^${LAYERDIR}/"
BBFILE_PRIORITY_meta-sensorhub = "6"
LAYERDEPENDS_meta-sensorhub = "core"
LAYERSERIES_COMPAT_meta-sensorhub = "kirkstone"
```
